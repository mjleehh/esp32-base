## examples/mfl_access_point/main/Kconfig
```kconfig
menu "AP example"
    config AP_NAME
        string "access point name"
        default "esp32exampleAP"
        help
            the SSID of the access point the ESP32 will create
    config AP_KEY
        string "access point key"
        default "VerySecret123"
        help
            the key for the access point the ESP32 will create

    config DEVICE_HOSTNAME
        string "hostname"
        default "yourESP32"
        help
            the hostname of the ESP32 on the network
endmenu
```

## examples/mfl_display_example/main/Kconfig
```kconfig
menu "display example"
    config DISPLAY_CLOCK_PIN
        int "clock pin"
        default 15
        help
            I2C clock pin of display bus
    config DISPLAY_DATA_PIN
        int "data pin"
        default 4
        help
            I2C data pin of display bus

    config DISPLAY_RESET_PIN
        int "reset pin"
        default 16
        help
            pin connected to reset port of display controller
endmenu
```

## examples/mfl_esp_httpd_example/main/Kconfig
```kconfig
menu "WiFi example"
    config WIFI_SSID
        string "wifi name"
        default "SomeWifi"
        help
            the SSID of the wifi the ESP32 will connect to
    config WIFI_KEY
        string "wifi key"
        default "VerySecret123"
        help
            the key for the wifi the ESP32 will connect to

    config DEVICE_HOSTNAME
        string "hostname"
        default "yourESP32"
        help
            the hostname of the ESP32 on the network
endmenu
```
